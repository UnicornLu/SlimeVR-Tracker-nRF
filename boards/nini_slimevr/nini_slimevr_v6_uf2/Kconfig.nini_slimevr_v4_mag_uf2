## boards/nini_slimevr/nini_slimevr_v6_uf2/Kconfig.nini_slimevr_v4_mag_uf2
```kconfig
# Copyright (c) 2024 Nordic Semiconductor ASA
# SPDX-License-Identifier: Apache-2.0

config BOARD_NINI_SLIMEVR_V6_UF2
	bool "NiNi SlimeVR V6 UF2 board"
	select SOC_NRF52833_QDAA
	select BOARD_HAS_DTS
	help
	  Enable support for the NiNi SlimeVR V4 MAG UF2 board with PWM RGB LED and I2C magnetometer.
```
