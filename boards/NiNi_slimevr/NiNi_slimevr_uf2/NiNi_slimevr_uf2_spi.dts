/* NiNi SlimeVR UF2 - SPI variant overlay */

/delete-node/ &i2c0;

&spi2 {
    status = "okay";

    icm45686: icm45686@0 {
        compatible = "invensense,icm45686";
        reg = <0>;
        spi-max-frequency = <8000000>;
        irq-gpios = <&gpio0 30 GPIO_ACTIVE_HIGH>;
    };
};
