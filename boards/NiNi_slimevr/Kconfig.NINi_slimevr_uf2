## boards/NiNi_slimevr/Kconfig.NINi_slimevr_uf2
```kconfig
# Copyright (c) 2024 Nordic Semiconductor ASA
# SPDX-License-Identifier: Apache-2.0

config BOARD_NINI_SMOL_uf2
	select SOC_NRF52833_QDAA
```

## boards/NiNi_slimevr/NiNi_slimevr/Kconfig.NiNi_slimevr_uf2
```kconfig
# Copyright (c) 2024 Nordic Semiconductor ASA
# SPDX-License-Identifier: Apache-2.0

config BOARD_NINI_SLIMEVR
	bool "NiNi SlimeVR board"
	select SOC_NRF52833_QDAA
	select BOARD_HAS_DTS
	help
	  Enable support for the NiNi SlimeVR board.
```

## boards/NiNi_slimevr/NiNi_slimevr/NiNi_slimevr_uf2_defconfig
```kconfig
# Copyright (c) 2024 Nordic Semiconductor ASA
# SPDX-License-Identifier: Apache-2.0

CONFIG_ARM_MPU=y
CONFIG_HW_STACK_PROTECTION=y

CONFIG_USB_DEVICE_STACK=y
CONFIG_USB_DEVICE_MANUFACTURER="SlimeVR"
CONFIG_USB_DEVICE_PRODUCT="NiNi_Unicorn & MINGYUE Smol SlimeVR"

CONFIG_BATTERY_USE_REG_BUCK_MAPPING=y
```

## boards/NiNi_slimevr/NiNi_slimevr/board.yml
```yaml
# Copyright (c) 2024 Nordic Semiconductor ASA
# SPDX-License-Identifier: Apache-2.0

board:
  name: nini_slimevr
  vendor: NiNi_Unicorn
  socs:
    - name: nrf52833
```

## boards/NiNi_slimevr/NiNi_slimevr_uf2/Kconfig.NINi_slimevr_uf2
```kconfig
# Copyright (c) 2024 Nordic Semiconductor ASA
# SPDX-License-Identifier: Apache-2.0

config BOARD_NINI_SLIMEVR_UF2
	bool
	select SOC_NRF52833_QDAA
	default y
```

## boards/NiNi_slimevr/NiNi_slimevr_uf2/Kconfig.NiNi_slimevr_uf2
```kconfig
# Copyright (c) 2024 Nordic Semiconductor ASA
# SPDX-License-Identifier: Apache-2.0

config NiNi_slimevr_uf2
	bool "NiNi SlimeVR UF2"
	select SOC_NRF52833_QDAA
```

## boards/NiNi_slimevr/NiNi_slimevr_uf2/board.yml
```yaml
# Copyright (c) 2024 Nordic Semiconductor ASA
# SPDX-License-Identifier: Apache-2.0

board:
  name: nini_slimevr_uf2
  vendor: nordic
  socs:
    - name: nrf52833
      variants:
      - name: 'spi'
```

## boards/NiNi_slimevr/NiNi_slimevr_v2_uf2/board.yml
```yaml
# Copyright (c) 2024 Nordic Semiconductor ASA
# SPDX-License-Identifier: Apache-2.0

board:
  name: NiNi_slimevr_v2_uf2
  vendor: NiNi_Unicorn
  socs:
    - name: nrf52833
```

## boards/NiNi_slimevr/board.yml
```yaml
# Copyright (c) 2024 Nordic Semiconductor ASA
# SPDX-License-Identifier: Apache-2.0

board:
  name: NiNi_slimevr
  vendor: NiNi_Unicorn & MINGYUE
  socs:
    - name: nrf52833
```

## boards/NiNi_slimevr_eco/NiNi_slimevr_eco_uf2/Kconfig.NINi_slimevr_eco_uf2
```kconfig
# Copyright (c) 2024 Nordic Semiconductor ASA
# SPDX-License-Identifier: Apache-2.0

config BOARD_NINI_SMOL_UF2
	bool
	select SOC_NRF52833_QDAA
	default y
```

## boards/nini_slimevr/NiNi_slimevr_v4_mag_uf2/Kconfig.NiNi_slimevr_v4_mag_uf2
```kconfig
config BOARD_NINI_SLIMEVR_V4_MAG_UF2
	bool "nini SlimeVR V4 MAG UF2 board (PWM RGB LED + I2C)"
	select SOC_NRF52833_QDAA
	select BOARD_HAS_DTS
	help
	  Enable support for the nini SlimeVR V4 MAG UF2 board with PWM RGB LED and I2C magnetometer.
```

## boards/nini_slimevr/NiNi_slimevr_v4_mag_uf2/board.yml
```yaml
board:
  name: nini_slimevr_v4_mag_uf2
  vendor: nini_Unicorn
  socs:
    - name: nrf52833
```

## boards/nini_slimevr/NiNi_slimevr_v4_uf2/Kconfig.NiNi_slimevr_v4_uf2
```kconfig
config BOARD_NINI_SLIMEVR_V4_UF2
	bool "NiNi SlimeVR V4 UF2 board (PWM RGB LED)"
	select SOC_NRF52833_QDAA
	select BOARD_HAS_DTS
	help
	  Enable support for the NiNi SlimeVR V4 UF2 board with PWM RGB LED.
```

## boards/nini_slimevr/NiNi_slimevr_v4_uf2/board.yml
```yaml
board:
  name: nini_slimevr_v4_uf2
  vendor: NiNi_Unicorn
  socs:
    - name: nrf52833
```

## boards/nini_slimevr/nini_slimevr_tracker_al/Kconfig.nini_slimevr_tracker_al
```kconfig
# Copyright (c) 2024 Nordic Semiconductor ASA
# SPDX-License-Identifier: Apache-2.0

config BOARD_NINI_SLIMEVR_TRACKER_AL
	bool "NiNi SlimeVR tracker AL (active-low) board"
	select SOC_NRF52833_QDAA
	select BOARD_HAS_DTS
	help
	  Enable support for the NiNi SlimeVR tracker AL board: two inverted (active-low) PWM LED channels and an I2C magnetometer.
```

## boards/nini_slimevr/nini_slimevr_tracker_al/board.yml
```yaml
# Copyright (c) 2024 Nordic Semiconductor ASA
# SPDX-License-Identifier: Apache-2.0

board:
  name: nini_slimevr_tracker_al
  full_name: NiNi_Unicorn & MINGYUE Smol SlimeVR MAG (active-low)
  vendor: nini_slimevr
  socs:
    - name: nrf52833
```

## boards/nini_slimevr/nini_slimevr_tracker_uf2/board.yml
```yaml
# Copyright (c) 2024 Nordic Semiconductor ASA
# SPDX-License-Identifier: Apache-2.0

board:
  name: nini_slimevr_tracker_uf2
  full_name: NiNi_Unicorn & MINGYUE Smol SlimeVR TRACKER
  vendor: nini_slimevr
  socs:
    - name: nrf52833
      variants:
      - name: 'LSM'
```

## boards/nini_slimevr/nini_slimevr_uf2/Kconfig.nini_slimevr_uf2
```kconfig
# Copyright (c) 2024 Nordic Semiconductor ASA
# SPDX-License-Identifier: Apache-2.0

config BOARD_NINI_SLIMEVR_UF2
	bool "NiNi SlimeVR UF2 board"
	select SOC_NRF52833_QDAA
	select BOARD_HAS_DTS
	help
	  Enable support for the nini SlimeVR UF2 board.
```

## boards/nini_slimevr/nini_slimevr_v2_uf2/Kconfig.nini_slimevr_v2_uf2
```kconfig
# Copyright (c) 2024 Nordic Semiconductor ASA
# SPDX-License-Identifier: Apache-2.0

config BOARD_NINI_SLIMEVR_V2_UF2
	bool "nini SlimeVR V2 UF2 board"
	select SOC_NRF52833_QDAA
	select BOARD_HAS_DTS
	help
	  Enable support for the nini SlimeVR V2 UF2 board.
```

## boards/nini_slimevr/nini_slimevr_v2_uf2/board.yml
```yaml
# Copyright (c) 2024 Nordic Semiconductor ASA
# SPDX-License-Identifier: Apache-2.0

board:
  name: nini_slimevr_v2_uf2
  vendor: nini_Unicorn
  socs:
    - name: nrf52833
```

## boards/nini_slimevr/nini_slimevr_v3_mag_uf2/Kconfig.nini_slimevr_v3_mag_uf2
```kconfig
# Copyright (c) 2024 Nordic Semiconductor ASA
# SPDX-License-Identifier: Apache-2.0

config BOARD_NINI_SLIMEVR_V3_MAG_UF2
	bool "NiNi SlimeVR V3 MAG UF2 board (I2C)"
	select SOC_NRF52833_QDAA
	select BOARD_HAS_DTS
	help
	  Enable support for the NiNi SlimeVR V3 MAG UF2 board with I2C communication.
```

## boards/nini_slimevr/nini_slimevr_v3_uf2/Kconfig.nini_slimevr_v3_uf2
```kconfig
# Copyright (c) 2024 Nordic Semiconductor ASA
# SPDX-License-Identifier: Apache-2.0

config BOARD_NINI_SLIMEVR_V3_UF2
	bool "NiNi SlimeVR V3 UF2 board"
	select SOC_NRF52833_QDAA
	select BOARD_HAS_DTS
	help
	  Enable support for the NiNi SlimeVR V3 UF2 board.
```

## boards/nini_slimevr/nini_slimevr_v5_uf2/Kconfig.nini_slimevr_v5_uf2
```kconfig
# Copyright (c) 2024 Nordic Semiconductor ASA
# SPDX-License-Identifier: Apache-2.0

config BOARD_NINI_SLIMEVR_V5_UF2
	bool "NiNi SlimeVR V5 UF2 board"
	select SOC_NRF52833_QDAA
	select BOARD_HAS_DTS
	help
	  Enable support for the NiNi SlimeVR V5 UF2 board.
```

## boards/nini_slimevr/nini_slimevr_v6_mag_uf2/Kconfig.nini_slimevr_v6_mag_uf2
```kconfig
# Copyright (c) 2024 Nordic Semiconductor ASA
# SPDX-License-Identifier: Apache-2.0

config BOARD_NINI_SLIMEVR_V6_MAG_UF2
	bool "NiNi SlimeVR V6 MAG UF2 board (v5 pin map on v4 layout, test)"
	select SOC_NRF52833_QDAA
	select BOARD_HAS_DTS
	help
	  Test board: v5_mag SPI/I2C/power mapping; omits v4 leds/pwm2 that share pins.
```
