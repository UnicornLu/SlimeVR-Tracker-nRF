/ {
	sram0@2001f000 {
		compatible = "zephyr,memory-region", "mmio-sram";
		reg = <0x2001f000 0x1000>;
		zephyr,memory-region = "RETAINED_MEM";
		status = "okay";

		retainedmem0: retainedmem {
			compatible = "zephyr,retained-ram";
			status = "okay";
		};
	};


	aliases {
        retainedmemdevice = &retainedmem0;
    };
};

